## drivers/aud/application_driver/Kconfig
```kconfig
#
# application specific audis driver configuration
#



config AUD_PBUS_PLUS
	tristate "driver for the pbus plus"
	depends on PCI && (SIMATIC_CP15431 || AUD_SOC1_CP1500)
	default n
	---help---
	  This option enables the driver
	  for the pbus plus PCI interface.

	  If you want to have this support embedded into your kernel, say Y.
	  To compile this driver as a module, choose M here.

	  more information <Manfred.Neugebauer@siemens.com>


config AUD_KERNEX
	tristate "Application specific audis driver (kernex.o)"
	depends on MIPS && AUD_SOC1 && AUD_EXCEPTION_HOOK
	default n
	help
	  Kernel Module "kernex.o"

	  If you want to have this support embedded into your kernel, say Y.
	  To compile this driver as a module, choose M here.
	 

config AUD_BOARDEX
	tristate "Application specific audis driver (boardex.o)"
	depends on MIPS && AUD_SOC1
	help
	  Kernel Module "boardex.o"

	  (Module 'kernex' needs config option Kernel hacking->Audis settings->Hook for a system exception handler)

	  If you want to have this support embedded into your kernel, say Y.
	  To compile this driver as a module, choose M here.

config AUD_CPXXX5HW
	tristate "Application specific audis driver (cpXXX5hw.o)"
	depends on MIPS && AUD_SOC1
	help
	  Kernel Module "cpXXX5hw.o"

	  (Module 'kernex' needs config option Kernel hacking->Audis settings->Hook for a system exception handler)

	  If you want to have this support embedded into your kernel, say Y.
	  To compile this driver as a module, choose M here.

config AUD_RUNFW
	tristate "Application specific audis driver (runfw.o)"
	depends on MIPS && AUD_SOC1
	help
	  Kernel Module "runfw.o"

	  (Module 'kernex' needs config option Kernel hacking->Audis settings->Hook for a system exception handler)
	
	  If you want to have this support embedded into your kernel, say Y.
	  To compile this driver as a module, choose M here.


config AUD_SIMPLE_SYNC_TIMER
	tristate "simple audis sync timer driver"
	help
	  this is a simple example of an audis synchronous timer driver
	  Manfred.Neugebauer@siemens.com

config AUD_SIMPLE_EVENT_DRIVER
	tristate "simple audis event driver"
	help
	  this is a simple example of an audis event driver
	  Manfred.Neugebauer@siemens.com
```

## drivers/aud/application_driver/powerpc/Kconfig
```kconfig
config AuD_PBUS_PLUS
	tristate "ppc based driver for the pbus plus"
	depends on MPC834x_MDS && PCI
	default n
	---help---
	  This option enables the ppc driver
	  for the pbus plus PCI interface.

	  If you want to have this support embedded into your kernel, say Y.
	  To compile this driver as a module, choose M here.

	  more information <Manfred.Neugebauer@siemens.com>
```

## drivers/net/aud_lan/Kconfig
```kconfig
#
# SOC LAN controller support
# h.b. Siemens AG Industry Sector IA ATS 11 14-August-2008
# m.n. overtaken for kernel 2.6.31.12
#

config AUD_SOC_LAN
	bool "AuD SOC LAN support"
	depends on NET_ETHERNET && MIPS && ( AUD_SOC1 || AUD_SOC2)
	select MII
	---help---
	  This option enables driver support for the SOC
	  embedded network controller.

	  If you have such a controller, say Y 

if  AUD_SOC_LAN

choice
	prompt "AUD SOC LAN SUPPORT"

config MIPS_ETHER_SOC
	bool "MIPS SOC simple LAN support"
	depends on MIPS && ( AUD_SOC1 || AUD_SOC2)
	help
 	  This option enables a simple non-rt driver support
          for the SOC1 embedded network controller.
          Herbert.Bernecker@siemens.com

config MIPS_ETHY_SOC
	bool "MIPS SOC LAN base driver"
	depends on MIPS && ( AUD_SOC1 || AUD_SOC2)
	help
 	  Enable a small kernel driver for the user space edd (ethernet device driver)
          Herbert.Bernecker@siemens.com

endchoice

endif
```

## lib/Kconfig.audis
```kconfig
config AUD_EXCEPTION_HOOK
        bool "Hook for a system exception handler"
        help
          This option will provide a pointer to a system exception
          handler which is initially set to NULL. This pointer may
          be initialized by a driver (see include/asm-generic/bug.h).

          When a problem is detected which causes the system to stop
          running (e.g. panic(), die()) this exception handler will
          be called to do some work before the system halts.

config ALLOW_POSIX_TIMER_OVERRUN
	bool "Allow Posix Timer overrun"
	default y
	help
	  Standard Linux restarts posix timers only when the waiting thread
	  dequeues the corresponding signal.
	  This option enables an immediate restart of posix timers when expired.
	  With this option a starved thread can recognize its late scheduling
	  by reading the overrun counter of its timer.

config AUD_PTRACE
	bool "Special debug handling"
	default y
	help
	  This option allows to attach all threads of a process
          immediately.

config RTX_EXTENDED_RT_DEBUGGING_SUPPORT
	bool "extended realtime debugging"
	default n
	help
	  This option allows an extended debugging
          of realtime threads with an immediate stop of
          all realtime threads when a breakpoint is hit.

config RTX_RT_WATCHDOG_SUPPORT
	bool "watchdog interface for realtime threads"
	default n
       depends on RTX_EXTENDED_RT_DEBUGGING_SUPPORT
	help
	  This option provides an interface for a user watchdog 
          thread to stop all running realtime threads.

config AUD_SPIN_LOCK_WORKAROUND
	bool "workaround to support user level spinlock"
	default y
       depends on PPC || ARM || MIPS
	help
	  user level spinlock with threads of static priority
	  need to block interrupts / scheduling.
	  this selection provides a workaround to do this.
	  for more information manfred.neugebauer@siemens.com

config AUD_FAST_SPIN_LOCK_WORKAROUND
	depends on AUD_SPIN_LOCK_WORKAROUND
	bool "workaround to support fast user level spinlock"
	default n
	help
	  user level spinlock with threads of static priority
	  need to block interrupts / scheduling.
	  this selection provides a fast user method for this.
	  for more information manfred.neugebauer@siemens.com

config AUD_EXTEND_COMMAND_LINE
	int "extend command line storage"
	range 256 2048
	default 256
	help
	  extend command line string storage for additional
	  kernel startup arguments

config AUD_LOW_LEVEL_PRINTK
	bool "Support direct printk"
	help
	  enables an immediate output of kernel messages
	  during Linux startup.

config AUD_FORCE_CR_FOR_KERNEL_PRINTK
	bool "add cr for kernel printk"
	help
	  some architectures require an additional cr
	  while using printk kernel messages

config AUD_LOW_LEVEL_KERNEL_DUMP
	bool "Support low level kernel dump messages"
	help
	  enables direct output of special kernel messages

config AUD_DISABLE_WDT_AUTOMODE
	bool "disable watchdog automode trigger"
	depends on 8xxx_WDT
	help
	  disable watchdog timer auto triggering for 8xxx watchdogs
	  (currently used with Siemens cp15432)

config AUD_FW_DEBUG_MODE_DRIVER
	bool "Audis firmware debug mode driver"
	default n
	help
	  activate a audis specific firmware debug mode driver
	  to modify console level of kernel printk

config USER_STACKSIZE_LIMIT_FOR_EMBEDDED
	bool "limit user stacksize"
	default n
	---help---
	  small systems using glibc may have problems with the default kernel
	  stacksize. This option
	  sets a smaller limit for standard and max user stacksize
config USER_STACKSIZE_RLIM_CUR	  
	hex "set rlim_cur for user stacksize"
	default 0x20000
	depends on USER_STACKSIZE_LIMIT_FOR_EMBEDDED
	---help---
	  You may need to activate this option 
	  to limit the stacksize for glibc based user applications
	  (This number is used when you create threads without attributes)
config USER_STACKSIZE_RLIM_MAX	  
	hex "set rlim_max for user stacksize"
	default 0x100000
	depends on USER_STACKSIZE_LIMIT_FOR_EMBEDDED
	---help---
	  You may need to activate this option 
	  to limit the maximum stacksize for glibc based user applications
```

## net/llc/Kconfig
```kconfig
config LLC
	tristate
	depends on NET

config LLC_DOWNLOAD
	bool "enable LLC download"
	default n
	depends on LLC
	help
	  code extension in ll_input.c and ll_output.c for download feature
	  (currently used on Siemens cp15431)

config LLC2
	tristate "ANSI/IEEE 802.2 LLC type 2 Support"
	select LLC
	help
	  This is a Logical Link Layer type 2, connection oriented support. 
	  Select this if you want to have support for PF_LLC sockets.
```
