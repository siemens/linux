## arch/mips/aud_soc/Kconfig
```kconfig
if  AUD_SOC

config AUD_SOC1
	bool
	default y

menu "Siemens AuD Soc Options"

choice
	prompt "board selection"
	default AUD_SOC1_CP342_5

config AUD_SOC1_CP1500
	bool "AuD Soc1 CP 1500"
	depends on MIPS && AUD_SOC1

config AUD_SOC1_CP342_5
	bool "AuD Soc1 CP342-5"
	depends on MIPS && AUD_SOC1

config AUD_SOC1_CP443_5
	bool "AuD Soc1 CP443-5"
	depends on MIPS && AUD_SOC1

config AUD_SOC1_CP1626
	bool "AuD Soc1 CP1626"
	depends on MIPS && AUD_SOC1

endchoice

config AUD_SOC1_CP1500_PROTO_VERSION
	int "CP 1500 board version"
        range 0 3
        default 3
	depends on AUD_SOC1_CP1500
	help
	  select version of cp1500 board

config SERIAL_AUD_SOC
	tristate "Siemens AuD SOC Serial port support"
	depends on MIPS && AUD_SOC
	select SERIAL_CORE
	help
	  Support for the on-chip UART on the Siemens AUD SOC1 CPU,
	  providing /dev/tty0.

config SERIAL_AUD_SOC_CONSOLE
	bool "Support for console on Siemens AUD SOC serial port"
	depends on SERIAL_AUD_SOC=y
	select SERIAL_CORE_CONSOLE
	help
	  Allow selection of the Siemens AUD SOC on-board serial port
	  for use as an virtual console.

config SERIAL_AUD_SOC_WITH_INTR
	bool "Siemens AUD SOC serial port with interrupt support"
	depends on SERIAL_AUD_SOC=y
	help
	  Use the Siemens AUD SOC on-board serial port with interrupts.

config SERIAL_SOC_INTR_MODE_REALTIME
	bool "Siemens AUD SOC serial port with realtime interrupt support"
	depends on SERIAL_AUD_SOC_WITH_INTR && RTX_DOMAIN
	help
	  Use the Siemens AUD SOC on-board serial port with realtime:
	  we buffer the characters within a realtime driver and propagate
	  them to the linux driver

config SERIAL_ENABLE_RT_HOT_KEY
	bool "hot key support to interrupt realtime domain"
	depends on SERIAL_SOC_INTR_MODE_REALTIME=y
	help
	  permanently running threads within the realtime domain can't
	  be debugged. The hot key mechanism allows these threads to be
	  interrupted.
	  This support should be selected together with the quota
	  configuration to get a linux cpu quota.

config SELECT_MIPS_COMPARE_TIMEBASE
	bool "select MIPS comparator as timebase"
	select CEVT_R4K
	help
	  MIPS AUD SOC boards use the external timers as default time base.
	  This default time base only works for tickbased configurations.
	  select this option when you want to use a tickless,
	  high resolution time base

endmenu

source "drivers/aud/application_driver/Kconfig"

endif
```

## arch/powerpc/platforms/83xx/Kconfig
```kconfig
menuconfig PPC_83xx
	bool "83xx-based boards"
	depends on 6xx
	select PPC_UDBG_16550
	select PPC_PCI_CHOICE
	select FSL_PCI if PCI
	select FSL_SOC
	select IPIC

if PPC_83xx

config MPC831x_RDB
	bool "Freescale MPC831x RDB"
	select DEFAULT_UIMAGE
	select PPC_MPC831x
	help
	  This option enables support for the MPC8313 RDB and MPC8315 RDB boards.

config MPC832x_MDS
	bool "Freescale MPC832x MDS"
	select DEFAULT_UIMAGE
	select PPC_MPC832x
	help
	  This option enables support for the MPC832x MDS evaluation board.

config MPC832x_RDB
	bool "Freescale MPC832x RDB"
	select DEFAULT_UIMAGE
	select PPC_MPC832x
	help
	  This option enables support for the MPC8323 RDB board.

config MPC834x_MDS
	bool "Freescale MPC834x MDS"
	select DEFAULT_UIMAGE
	select PPC_MPC834x
	help
	  This option enables support for the MPC 834x MDS evaluation board.

	  Be aware that PCI buses can only function when MDS board is plugged
	  into the PIB (Platform IO Board) board from Freescale which provide
	  3 PCI slots.  The PIBs PCI initialization is the bootloader's
	  responsibility.

choice
	prompt "MPC834x board selection"
	default MPC834x_MDS_DEFAULT
	depends on MPC834x_MDS

config  MPC834x_MDS_DEFAULT
	bool "MPC834x_MDS default board"
	depends on MPC834x_MDS
	---help---
	  select a generic version for this board configuration
	  If unsure, say y.

config  SIMATIC_CP15431
	bool "SIMATIC CP15431 board"
	depends on MPC834x_MDS
	---help---
	  Enables support for Siemens CP15431 devices
	  If unsure, say n.

config  SIMATIC_NET_SCALANCE_W_OLD
	bool "SCALANCE W Platform"
	depends on MPC834x_MDS
	select SIMATIC_NET_SCALANCE_W
	---help---
	  Enables support for Siemens SCALANCE W devices
	  based on MPC834x (old board version)
	  If unsure, say n.

endchoice

#if MPC834x_MDS
source "drivers/aud/application_driver/Kconfig"
#endif

config  MPC834x_GLOBAL_TIMER_MODULE
	bool "MPC834x_global_timer_module"
	depends on MPC834x_MDS
	default n
	---help---
	  Enables support for global timer modules provided with mpc834x
	  If unsure, say n.

config MPC834x_ITX
	bool "Freescale MPC834x ITX"
	select DEFAULT_UIMAGE
	select PPC_MPC834x
	help
	  This option enables support for the MPC 834x ITX evaluation board.

	  Be aware that PCI initialization is the bootloader's
	  responsibility.

config MPC836x_MDS
	bool "Freescale MPC836x MDS"
	select DEFAULT_UIMAGE
	help
	  This option enables support for the MPC836x MDS Processor Board.

config MPC836x_RDK
	bool "Freescale/Logic MPC836x RDK"
	select DEFAULT_UIMAGE
	select FSL_GTM
	select FSL_LBC
	help
	  This option enables support for the MPC836x RDK Processor Board,
	  also known as ZOOM PowerQUICC Kit.

config MPC837x_MDS
	bool "Freescale MPC837x MDS"
	select DEFAULT_UIMAGE
	select PPC_MPC837x
	help
	  This option enables support for the MPC837x MDS Processor Board.

config MPC837x_RDB
	bool "Freescale MPC837x RDB"
	select DEFAULT_UIMAGE
	select PPC_MPC837x
	help
	  This option enables support for the MPC837x RDB Board.

config SBC834x
	bool "Wind River SBC834x"
	select DEFAULT_UIMAGE
	select PPC_MPC834x
	help
	  This option enables support for the Wind River SBC834x board.

config ASP834x
	bool "Analogue & Micro ASP 834x"
	select PPC_MPC834x
	select REDBOOT
	help
	  This enables support for the Analogue & Micro ASP 83xx
	  board.

config KMETER1
	bool "Keymile KMETER1"
	select DEFAULT_UIMAGE
	select QUICC_ENGINE
	help
	  This enables support for the Keymile KMETER1 board.


endif

# used for usb
config PPC_MPC831x
	bool

# used for math-emu
config PPC_MPC832x
	bool

# used for usb
config PPC_MPC834x
	bool

# used for usb
config PPC_MPC837x
	bool
```

## arch/powerpc/sysdev/Kconfig
```kconfig
# For a description of the syntax of this configuration file,
# see Documentation/kbuild/kconfig-language.txt.
#

config PPC4xx_PCI_EXPRESS
	bool
	depends on PCI && 4xx
	default n

config PPC_MSI_BITMAP
	bool
	depends on PCI_MSI
	default y if MPIC
	default y if FSL_PCI

config DCU_ENABLE
	bool "Enable L2 Data Cache"
	depends on 460EX || 460SX || 440GX
	help
	 Enable L-2 D-Cache
	default n if 460EX
	default y if 460SX
	default y if 440GX
```

## drivers/aud/Kconfig.debug
```kconfig
config RTX_DYNAMIC_MAJOR_NUMBER
	bool "Create dynamic major number for the Audis device node"
	depends on RTX_DOMAIN
	default y
	---help---
	  If this option is enabled the system allocates a major number
	  for the Audis device node "/dev/audis" dynamically.

config RTX_STATIC_MAJOR_NUMBER
	int "Static major number of Audis device node (200 - 240)"
	depends on RTX_DOMAIN && !RTX_DYNAMIC_MAJOR_NUMBER
	range 200 240
	default 220
	---help---
	  This option helps to pre-define a static major number for the
	  Audis device node "/dev/audis" in the range between 200..240.

config RTX_DOMAIN_INTEGRITY_CHECK
	bool "System integrity check"
	depends on RTX_DOMAIN
	default n
	---help---
	  This option helps to verify the correct invocation context. 
	  On entry of critical Linux services a panic situation
	  may occur if the caller is not running over the Linux domain.

config RTX_OPTIMIZE_FOR_RELEASE
	bool "Code optimizations"
	depends on RTX_DOMAIN
	default y
	--help---
	  If this option is disabled additional code is activated to 
	  print out extra messages for signal/event/futex handling. The delivery
	  of signals/events will be delayed. Thus, this option should only be used
	  for test purposes. This option also depends on RT_SIGNAL_VERBOSE,
	  RT_EVENT_VERBOSE and RT_FUTEX_VERBOSE (see linux/aud/rt_base.h).
	
config RTX_DOMAIN_STOP_ON_PANIC
	bool "RT-domain stopping on Linux panic"
	depends on RTX_DOMAIN
	default n
	--help---
	  If this option is disabled and the Linux domain crashes, the RT-domain 
	  does not stop working. Otherwise, if this option is enabled and the Linux 
	  domain crashes the RT-domain is never invoked again.

config RTX_SCHED_RR_TIMESLICE_US
	int "Round robin scheduling timeslice (usecs)"
	default 10000
	depends on RTX_DOMAIN
	--help---
	  This value defines the timeslice (microseconds) for round robin threads.

config RTX_THREAD_GROUP_SUPPORT
	bool "Realtime thread group support"
	depends on RTX_DOMAIN && RTX_DOMAIN_HRT
	default n
	--help---
	  If this option is enabled, realtime thread groups are supported
	  according to the A&D-API.

if RTX_THREAD_GROUP_SUPPORT

config RTX_MAX_THREAD_GROUPS
	int "Maximum number of thread groups"
	default 5
	--help---
	  This value defines the maximum number of thread groups supported.

config RTX_THREAD_GROUP_INTERVAL_US
	int "Thread group interval (usecs)"
	default 1000
	--help---
	  The thread group interval (microseconds) defines the time span
	  for the thread group quota handling. At the start of the interval
	  a new quota is assigned to all thread groups.
	  Note: When using round robin threads (scheduling policy SCHED_RR)
	  in thread groups, the scheduling timeslice (see RTX_SCHED_RR_TIMESLICE_US)
	  should only be a fraction of the thread group interval.

endif

config RTX_DISABLE_WRITE_DAEMON
	bool "Disable write daemon"
	depends on RTX_DOMAIN
	default n
	--help---
	  If this option is enabled RT-printf's to stdout/stderr will be delegated
	  to the LX-domain. This option should only be enabled for test purposes,
	  otherwise realtime behaviour may be corrupted.

config RTX_DOMAIN_EXCLUSIVE_MODE
	bool "RT-domain exclusive mode"
	depends on RTX_DOMAIN && SMP && X86
	default n
	--help---
	  If this option is enabled the core on which the realtime process
	  is running forces all other processor cores to run in an idle loop
	  while the RT-domain is active.
	  Note: This mode allows only one realtime process to be running.

config RTX_THREAD_RUNTIME
	bool "Runtime accounting for RT-threads"
	depends on RTX_DOMAIN && RTX_DOMAIN_HRT
	default y
	--help---
	  If this option is enabled the runtime of RT-threads is accounted.
	  Note: The amount of time a thread has been in running state also
	  implicates the amount of time the thread has been interrupted.

config RTX_RETURN_TO_LINUX
	def_bool n
	depends on RTX_DOMAIN && X86
	prompt "Support for audis_return_to_linux() functionality"
	---help---
	  Include support for audis_return_to_linux(). Voluntarily give up the 
	  RT-domain and return to Linux.

config RTX_PRINT_BUF_LEN_KB
	int "Size of the print buffer (KB)"
	default 16
	depends on RTX_DOMAIN
	--help---
	  This value defines the size of the print buffer in KB. All the messages
	  written from RT-threads of a RT application to stdout/stderr are cumulated
	  in the print buffer. A Linux write daemon is responsible to really write
	  these messages to stdout/stderr whenever there is no RT activity in the
	  system.  
	  This value can be overwritten dynamically by the boot parameter 
	  "audis_print_buf_len=" which is also interpreted as a value in KB.
```

## drivers/aud/Kconfig.trace
```kconfig
config RTX_TRACE
	bool "Tracing support"
	depends on RTX_DOMAIN
	select FRAME_POINTER
	select KALLSYMS
	select PROC_FS
	---help---
	  Activate this option if you want to use per-function tracing of
	  the kernel. The tracer will collect data via instrumentation
	  features like the one below or with the help of explicit calls
	  of rt_trace_xxx(). See include/linux/aud/rt_trace.h for the
	  in-kernel tracing API. The collected data and runtime control
	  is available via /proc/audis/trace/*.

if RTX_TRACE

config RTX_TRACE_ENABLE
	bool "Enable tracing on boot"
	default y
	---help---
	  Disable this option if you want to arm the tracer after booting
	  manually ("echo 1 > /proc/audis/trace/enable"). This can reduce
	  boot time on slow embedded devices due to the tracer overhead.

config RTX_TRACE_MCOUNT
	bool "Instrument function entries"
	default y
	select FUNCTION_TRACER
	select TRACING
	select CONTEXT_SWITCH_TRACER
	select FTRACE_MCOUNT_RECORD
 	select DYNAMIC_FTRACE
	---help---
	  When enabled, records every kernel function entry in the tracer
	  log. While this slows down the system noticeably, it provides
	  the highest level of information about the flow of events.
	  However, it can be switched off in order to record only explicit
	  RTX domain system trace points.

config RTX_TRACE_IRQSOFF
	bool "Trace IRQs-off times"
	default y
	---help---
	  Activate this option if the RTX domain system shall trace the longest path
	  with hard-IRQs switched off.

config RTX_TRACE_SHIFT
	int "Depth of trace log (14 => 16Kpoints, 15 => 32Kpoints)"
	range 10 18
	default 14
	---help---
	  The number of trace points to hold tracing data for each
	  trace path, as a power of 2.

config RTX_TRACE_VMALLOC
	bool "Use vmalloc'ed trace buffer"
	default y if EMBEDDED
	---help---
	  Instead of reserving static kernel data, the required buffer
	  is allocated via vmalloc during boot-up when this option is
	  enabled. This can help to start systems that are low on memory,
	  but it slightly degrades overall performance. Try this option
	  when a traced kernel hangs unexpectedly at boot time.

config RTX_TRACE_PANIC
	bool "Enable panic back traces"
	default y
	---help---
	  Provides services to freeze and dump a back trace on panic
	  situations. This is used e.g. on ordinary kernel oopses. 
	  You can control the number of printed back trace points 
	  via /proc/audis/trace.

config RTX_TRACE_CONTEXT_SWITCH
	bool "Enable context switch trace"
	default y
	---help---
	  Activate this option if the context switches (LX- and RT-domain)
	  shall be traced.

endif
```
