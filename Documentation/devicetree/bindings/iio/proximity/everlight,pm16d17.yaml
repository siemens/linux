## Documentation/devicetree/bindings/iio/proximity/everlight,pm16d17.yaml
```yaml
# SPDX-License-Identifier: (GPL-2.0 OR BSD-2-Clause)
%YAML 1.2
---
$id: http://devicetree.org/schemas/iio/proximity/everlight,pm16d17.yaml#
$schema: http://devicetree.org/meta-schemas/core.yaml#

title: Everlight PM-16D17 Ambient Light & Proximity Sensor

maintainers:
  - Chao Zeng <chao.zeng@siemens.com>

description: |
  This sensor uses standard I2C interface. Interrupt function is not covered.
  Datasheet: https://en.everlight.com/sensor/category-proximity_sensor/digital_proximity_sensor/

properties:
  compatible:
    enum:
      - everlight,pm16d17

  reg:
    maxItems: 1

  ps-gain:
    description: Receiver gain of proximity sensor
    $ref: /schemas/types.yaml#/definitions/uint32
    enum: [1, 2, 4, 8]
    default: 1

  ps-itime:
    description: Conversion time for proximity sensor [ms]
    $ref: /schemas/types.yaml#/definitions/string
    enum:
      - "0.4"
      - "0.8"
      - "1.6"
      - "3.2"
      - "6.3"
      - "12.6"
      - "25.2"
    default: "0.4"

  ps-wtime:
    description: Waiting time for proximity sensor [ms]
    $ref: /schemas/types.yaml#/definitions/string
    enum:
      - "12.5"
      - "25"
      - "50"
      - "100"
      - "200"
      - "400"
      - "800"
      - "1600"
    default: "12.5"

  ps-ir-led-pulse-count:
    description: IR LED drive pulse count
    $ref: /schemas/types.yaml#/definitions/uint32
    minimum: 1
    maximum: 256
    default: 1

  ps-offset-cancel:
    description: |
      When PS offset cancel function is enabled, the result of subtracting any
      value specified by the PS offset cancel register from the internal PS
      output data is written to the PS output data register.
    $ref: /schemas/types.yaml#/definitions/uint32
    default: 0
    maximum: 65535

required:
  - compatible
  - reg

unevaluatedProperties: false

examples:
  - |
    i2c {
        #address-cells = <1>;
        #size-cells = <0>;

        lightsensor: pm16d17@44 {
            compatible = "everlight,pm16d17";
            reg = <0x44>;

            ps-gain = <1>;
            ps-itime = "0.4";
            ps-wtime = "12.5";
            ps-ir-led-pulse-count = <1>;
            ps-offset-cancel = <280>;
        };
    };
```

## Documentation/devicetree/bindings/soc/ti/ti,am62-system-controller.yaml
```yaml
# SPDX-License-Identifier: GPL-2.0-only OR BSD-2-Clause
%YAML 1.2
---
$id: http://devicetree.org/schemas/soc/ti/ti,am62-system-controller.yaml#
$schema: http://devicetree.org/meta-schemas/core.yaml#

title: TI AM62 System Controller Registers R/W

maintainers:
  - Kishon Vijay Abraham I <kishon@ti.com>
  - Roger Quadros <rogerq@kernel.org>

properties:
  compatible:
    items:
      - enum:
          - ti,am62-system-controller
          - ti,am62a-system-controller
      - const: syscon
      - const: simple-mfd

  reg:
    maxItems: 1

  "#address-cells":
    const: 1

  "#size-cells":
    const: 1

  ranges: true

patternProperties:
  "^chipid@[0-9a-f]+$":
    type: object
    $ref: /schemas/hwinfo/ti,k3-socinfo.yaml#

  "^syscon@[0-9a-f]+$":
    type: object
    $ref: /schemas/mfd/syscon.yaml#
    unevaluatedProperties: false
    properties:
      compatible:
        items:
          - const: ti,am62-usb-phy-ctrl
          - const: syscon

required:
  - compatible
  - reg
  - "#address-cells"
  - "#size-cells"
  - ranges

additionalProperties: false

examples:
  - |
    syscon@43000000 {
        compatible = "ti,am62-system-controller", "syscon", "simple-mfd";
        reg = <0x43000000 0x20000>;
        bootph-all;
        #address-cells = <1>;
        #size-cells = <1>;
        ranges = <0x0 0x43000000 0x20000>;

        chipid@14 {
            compatible = "ti,am654-chipid";
            reg = <0x14 0x4>;
            bootph-all;
        };

        syscon@4008 {
            compatible = "ti,am62-usb-phy-ctrl", "syscon";
            reg = <0x4008 0x4>;
        };
    };
```

## Documentation/devicetree/bindings/soc/ti/ti,am654-pvu.yaml
```yaml
# SPDX-License-Identifier: (GPL-2.0-only OR BSD-2-Clause)
# Copyright (c) Siemens AG, 2024
%YAML 1.2
---
$id: http://devicetree.org/schemas/soc/ti/ti,am654-pvu.yaml#
$schema: http://devicetree.org/meta-schemas/core.yaml#

title: TI AM654 Peripheral Virtualization Unit

maintainers:
  - Jan Kiszka <jan.kiszka@siemens.com>

properties:
  compatible:
    enum:
      - ti,am654-pvu

  reg:
    minItems: 2

  reg-names:
    items:
      - const: cfg
      - const: tlbif

  interrupts:
    items:
      - description: fault interrupt

  interrupt-names:
    items:
      - const: pvu

required:
  - compatible
  - reg
  - interrupts
  - interrupt-names

additionalProperties: false

examples:
  - |
    ti-pvu@30f80000 {
        compatible = "ti,am654-pvu";
        reg = <0x30f80000 0x1000>,
              <0x36000000 0x100000>;
        reg-names = "cfg", "tlbif";
        interrupts-extended = <&intr_main_navss 390>;
        interrupt-names = "pvu";
    };
```

## Documentation/devicetree/bindings/soc/ti/ti,am654-system-controller.yaml
```yaml
# SPDX-License-Identifier: GPL-2.0-only OR BSD-2-Clause
%YAML 1.2
---
$id: http://devicetree.org/schemas/soc/ti/ti,am654-system-controller.yaml#
$schema: http://devicetree.org/meta-schemas/core.yaml#

title: TI AM654 System Controller Registers R/W

maintainers:
  - Kishon Vijay Abraham I <kishon@ti.com>
  - Roger Quadros <rogerq@kernel.org>

properties:
  compatible:
    items:
      - enum:
          - ti,am654-system-controller
      - const: syscon
      - const: simple-mfd

  reg:
    maxItems: 1

  "#address-cells":
    const: 1

  "#size-cells":
    const: 1

  ranges: true

  dss-oldi-io-ctrl@41e0:
    type: object
    $ref: /schemas/mfd/syscon.yaml#
    properties:
      compatible:
        items:
          - const: ti,am654-dss-oldi-io-ctrl
          - const: syscon

  clock-controller@4140:
    type: object
    $ref: /schemas/clock/ti,am654-ehrpwm-tbclk.yaml#
    description:
      Clock provider for TI EHRPWM nodes.

patternProperties:
  "^phy@[0-9a-f]+$":
    type: object
    $ref: /schemas/phy/ti,phy-gmii-sel.yaml#

  "^clock@[0-9a-f]+$":
    type: object
    $ref: /schemas/soc/ti/ti,am654-serdes-ctrl.yaml#

required:
  - compatible
  - reg
  - "#address-cells"
  - "#size-cells"
  - ranges

additionalProperties: false

examples:
  - |
    syscon@40f00000 {
        compatible = "ti,am654-system-controller", "syscon", "simple-mfd";
        reg = <0x40f00000 0x20000>;
        ranges = <0x0 0x40f00000 0x20000>;
        #address-cells = <1>;
        #size-cells = <1>;

        phy@4040 {
            compatible = "ti,am654-phy-gmii-sel";
            reg = <0x4040 0x4>;
            #phy-cells = <1>;
        };
    };
```

## arch/arm/mach-feroceon-kw/Kconfig
```kconfig
if ARCH_FEROCEON_KW

choice
	prompt "Feroceon-KW SoC type"
	default MV88F6281

config  MV88F6281
	bool "88F6281/88F6192/88F6190/88F6180/ SoC"
	---help---
	Choosing this option will generate a linux kernel for the 88F6281/88F6192/88F6190/88F6180 SoC


config  MV98DX3121
        bool "MV98DX3121 SoC"
        ---help---
        Choosing this option will generate a linux kernel for the  MV98DX3121 SoC

config  MV98DX4122
        bool "MV98DX4122 SoC"
        ---help---
        Choosing this option will generate a linux kernel for the  MV98DX4122 SoC

config  X500PROTOTYPE
        bool "X500 prototype"
        ---help---
        Choosing this option will generate a linux kernel for the  X500

endchoice

config  OVERRIDE_ETH_CMDLINE
	bool "Override command line definitions for SoC Networking"
	depends on MV88F6281 || MV98DX3121 || MV98DX4122 || X500PROTOTYPE

	---help---
	Choosing this option will override MAC address and MTU definition of kernel command line. 
        The GbE driver will use the setting from kernel config

config AUD_EXCEPTION_HOOK
	bool "exception hook for CP useage"
	default y
	help
	  Include support to provide a hook which is called when
	  an exception for a user application occurs.
	  (see Friedrich.Ensslin@siemens.com)

endif
```

## arch/arm/plat-feroceon/mv_drivers_lsp/mv_network/Kconfig
```kconfig
config  MV_ETHERNET
        bool "Networking Support"
	depends on MV_INCLUDE_GIG_ETH
        ---help---
        Choose this option to support Marvell Gigabit Ethernet Controller 

config MV_ETH_PORTS_NUM
	int "Number of Marvell Giga Ethernet controllers"
	depends on MV_ETHERNET
	default 0 

if MV_ETHERNET

menu "Network Interface Configuration"

config  MV_ETH_0_MTU
	int "Giga port #0 MTU value"
	depends on (MV_ETH_PORTS_NUM != 0)
 	default 1500
        ---help---
	Default MTU value for Marvell Giga port #0

config  MV_ETH_0_MACADDR
        string "Giga port #0 MAC Address"
        depends on (MV_ETH_PORTS_NUM != 0)
        default "00:00:00:00:00:80"
        ---help---
        Default MAC address for Marvell Giga port #0 

config  MV_ETH_1_MTU
        int "Giga port #1 MTU value"
        depends on (MV_ETH_PORTS_NUM != 0) && (MV_ETH_PORTS_NUM != 1)
        default 1500
        ---help---
	Default MTU value for Marvell Giga port #1

config  MV_ETH_1_MACADDR
        string "Giga port #1 MAC Address"
        depends on (MV_ETH_PORTS_NUM != 0) && (MV_ETH_PORTS_NUM != 1)
        default "00:00:00:00:00:81"
        ---help---
        Default MAC address for Marvell Giga port #1

config  MV_ETH_2_MTU
        int "Giga port #2 MTU value"
        depends on (MV_ETH_PORTS_NUM != 0) && (MV_ETH_PORTS_NUM != 1) && (MV_ETH_PORTS_NUM != 2)
        default 1500
        ---help---
        Default MTU value for Marvell Giga port #2

config  MV_ETH_2_MACADDR
        string "Giga port #2 MAC Address"
        depends on (MV_ETH_PORTS_NUM != 0) && (MV_ETH_PORTS_NUM != 1) && (MV_ETH_PORTS_NUM != 2)
        default "00:00:00:00:00:82"
        ---help---
        Default MAC address for Marvell Giga port #2

config  MV_ETH_3_MTU
        int "Giga port #3 MTU value"
        depends on (MV_ETH_PORTS_NUM != 0) && (MV_ETH_PORTS_NUM != 1) && (MV_ETH_PORTS_NUM != 2) && (MV_ETH_PORTS_NUM != 3)
        default 1500
        ---help---
        Default MTU value for Marvell Giga port #3

config  MV_ETH_3_MACADDR
        string "Giga port #3 MAC Address"
        depends on (MV_ETH_PORTS_NUM != 0) && (MV_ETH_PORTS_NUM != 1) && (MV_ETH_PORTS_NUM != 2) && (MV_ETH_PORTS_NUM != 3)
        default "00:00:00:00:00:83"
        ---help---
        Default MAC address for Marvell Giga port #3

endmenu
endif

if MV_ETHERNET
menu "Rx/Tx Queue Configuration"

config  MV_ETH_MULTI_Q
        bool "Support for muliple queues"
        default y
        ---help---
          Multiple queues support.

config  MV_ETH_RX_Q_NUM
        int
        default 8 if MV_ETH_MULTI_Q
        default 1 if !MV_ETH_MULTI_Q
        ---help---
          Number of RX queues.

config  MV_ETH_TX_Q_NUM
        int
        default 8 if MV_ETH_MULTI_Q    
        default 1 if !MV_ETH_MULTI_Q
        ---help---
          Number of TX queues.

config MV_ETH_NUM_OF_RX_DESCR
	int
	depends on (MV_ETH_PORTS_NUM != 0)
        default 64 if MV_ETH_MULTI_Q    
        default 128 if !MV_ETH_MULTI_Q    
        ---help---
	The number of Rx descriptors in each Rx queue.

config MV_ETH_NUM_OF_TX_DESCR
	int
	depends on (MV_ETH_PORTS_NUM != 0)
        default 532 if MV_ETH_MULTI_Q    
        default 148 if !MV_ETH_MULTI_Q    
        ---help---
	The number of Tx descriptors in each Tx queue.

endmenu
endif

if MV_ETHERNET
menu "TCP/UDP Offloading"

config  MV_ETH_TSO
        bool "TSO Support for Marvell network interface"
	default y
        ---help---
        Adds TSO support for TCP segmentation offload on Marvell network interface.

config  MV_ETH_UFO
        bool "UFO Support for Marvell network interface"
        ---help---
        Adds UFO support for transmit UDP buffers larger than MTU size on 
        Marvell network interface.
        UFO stands for UDP Fragmentation Offload

config  MV_ETH_LRO_UDP
        bool "LRO UDP support for Marvell network interface"
	depends on INET_LRO
        ---help---
        Adds LRO support for receiving large UDP datagrams on Marvell network interface.
        LRO stands for Large Receive Offload

endmenu
endif

if MV_ETHERNET
menu "Control and Statistics"

config  MV_ETH_PROC
	bool "Support eth proc FS "
	default y
	---help---
	  Use mv_eth_tool to control Marvell network interface driver.

config  MV_ETH_STATS_ERROR
        bool "Collect error statistics"
	---help---
	Marvell network interface driver collect minimal number of statistics. 
	Only for error conditions. Can be displayed using mv_eth_tool.

config  MV_ETH_STATS_INFO
        bool "Collect event statistics"
        ---help---
	Marvell network interface driver collect event statistics. 
	Provide more information about driver functionality and almost doesn't 
	effect performance. Can be displayed using mv_eth_tool.

config  MV_ETH_STATS_DEBUG
        bool "Collect debug statistics"
        ---help---
	Marvell network interface driver collect a lot of statistics. 
	Used for Debug mode. Decrease performance. Can be displayed using mv_eth_tool.

config  MV_LINUX_COUNTERS_DISABLE
	bool "Disable collection of SNMP statistics and Netfilter Contract statistics"
	default n
	---help---
	Disable collection of SNMP statistics and Netfilter Contract statistics to improve performance.

endmenu
endif

if (MV_ETHERNET)
menu "Advanced Features"

config  MV_ETH_TIMER_PERIOD
        int "Periodical timer period"
        default 10
        ---help---
          Periodical timer period for clenup in [msec].
config  MV_SKB_HEADROOM
        int "SKB headroom size"
        default 16
        ---help---
          Customize SKB headroom size. Must be power of 2.

config	MV_SKB_REUSE
	bool "Try to reuse SKB"
	default y
	---help---
	  Reuse SKB from TX to RX

config  MV_ETH_NFP
        bool "Use Network Fast Processing (NFP)"
	default y
        ---help---
        Choosing this option will include NFP support in the image.

config MV_ETH_NFP_AGING_TIMER
        int "NFP aging timer interval"
        depends on MV_ETH_NFP
        default 15
        ---help---
        The NFP aging mechanism timer interval. If unsure, leave default value.

config MV_ETH_NFP_NAT_SUPPORT
        bool "Support NFP NAT"
        depends on MV_ETH_NFP && NF_CONNTRACK_ENABLED
        ---help---
        Choosing this option will enable NFP NAT support.

config MV_ETH_NFP_FDB_SUPPORT
	bool "Support NFP Bridging"
	depends on MV_ETH_NFP && BRIDGE
	default n
	 ---help---
	Choosing this option will enable NFP Bridging.

config  MV_NFP_STATS
        bool "Collect NFP statistics"
	depends on MV_ETH_NFP
        default n
        ---help---
        Collect NFP statistics. Can be displayed using mv_eth_tool.

endmenu
endif

config MV_GATEWAY
        bool "Gateway support"
	depends on MV_ETHERNET
        ---help---
	Choose this option to support Gigabit Ethernet Controller connected to 
        on-board QuarterDeck switch family

if MV_GATEWAY

menu "Gateway Interface Configuration"

config  MV_GTW_CONFIG
	string "Network interface configuration"
	default "(00:11:66:11:66:11,0)(00:22:77:22:77:22,1:2:3:4),mtu=1500"
	---help---
	 Set the network interface configuration. For each interface, define the interface 
	 name, MAC address and participating ports, at the end (optionally) set the 
         interfaces MTU. For example, the default configuration defines two interfaces, 
         eth0 and eth1, and sets the MTU to 1500.

endmenu

menu "Gateway Features"

config  MV_GTW_IGMP
        bool "L2 IGMP Snooping support"
        default y
        ---help---
          Support L2 IGMP snooping at the switch level, i.e. directing L3 routed multicast
          stream to the specific L2 port which originally received an IGMP Join message,
          instead of fluding all VLAN ports.

config  MV_GTW_LINK_STATUS
	bool "Link status change indications"
	default y
	---help---
	  Support Phy link status change indications.

endmenu

endif
```
